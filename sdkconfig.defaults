## sdkconfig.defaults
```kconfig
# Shared config (target-specific overrides in sdkconfig.defaults.esp32s3 / .esp32p4)

# ESP32-P4: allow silicon rev < 3.0 (P4-Nano ships with rev 1.x)
# These are ignored on non-P4 targets
CONFIG_ESP32P4_SELECTS_REV_LESS_V3=y
CONFIG_ESP32P4_REV_MIN_100=y

# SPI Slave
CONFIG_SPI_SLAVE_ISR_IN_IRAM=y

# HTTP Server
CONFIG_HTTPD_MAX_REQ_HDR_LEN=1024
CONFIG_HTTPD_MAX_URI_LEN=512
CONFIG_HTTPD_PURGE_BUF_LEN=64

# Partition Table
CONFIG_PARTITION_TABLE_CUSTOM=y
CONFIG_PARTITION_TABLE_CUSTOM_FILENAME="partitions.csv"

# FreeRTOS
CONFIG_FREERTOS_HZ=1000

# System
CONFIG_ESP_MAIN_TASK_STACK_SIZE=8192
CONFIG_ESP_SYSTEM_EVENT_TASK_STACK_SIZE=4096

# Log level
CONFIG_LOG_DEFAULT_LEVEL_INFO=y

# mDNS
CONFIG_MDNS_MAX_SERVICES=4
```

## sdkconfig.defaults.esp32p4
```kconfig
# Target
CONFIG_IDF_TARGET="esp32p4"

# Allow silicon revision < 3.0 (P4-Nano ships with rev 1.x)
CONFIG_ESP32P4_SELECTS_REV_LESS_V3=y
CONFIG_ESP32P4_REV_MIN_100=y

# PSRAM - up to 32MB on P4
CONFIG_SPIRAM=y
CONFIG_SPIRAM_SPEED_200M=y
CONFIG_SPIRAM_USE_MALLOC=y
CONFIG_SPIRAM_MALLOC_ALWAYSINTERNAL=4096

# SPI Slave
CONFIG_SPI_SLAVE_ISR_IN_IRAM=y

# WiFi via ESP32-C6 (esp_hosted over SDIO)
CONFIG_ESP_WIFI_REMOTE_ENABLED=y
CONFIG_ESP_HOSTED_CP_TARGET_ESP32C6=y

# Ethernet
CONFIG_ETH_USE_ESP32_EMAC=y
CONFIG_ETH_PHY_INTERFACE_RMII=y

# HTTP Server
CONFIG_HTTPD_MAX_REQ_HDR_LEN=1024
CONFIG_HTTPD_MAX_URI_LEN=512

# Partition Table
CONFIG_PARTITION_TABLE_CUSTOM=y
CONFIG_PARTITION_TABLE_CUSTOM_FILENAME="partitions.csv"

# FreeRTOS
CONFIG_FREERTOS_HZ=1000

# System
CONFIG_ESP_MAIN_TASK_STACK_SIZE=8192
CONFIG_ESP_SYSTEM_EVENT_TASK_STACK_SIZE=4096

# Log level
CONFIG_LOG_DEFAULT_LEVEL_INFO=y

# mDNS
CONFIG_MDNS_MAX_SERVICES=4
```
